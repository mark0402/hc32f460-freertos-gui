/* SPDX-License-Identifier: MIT */
/* Copyright (c) 2026 mark0402 */
// =======================================================================
// Chinese 16x16 dot-matrix font rendering (pure hex data; compiler-agnostic)
//
// Data (g_cn_font) is generated by tools/gen_chinese_font.py into
// chinese_font_data.c. This file provides the lookup + draw primitives
// built on top of tftlcd's LCD_Draw_ColorPoint().
// =======================================================================
#include "chinese_font.h"
#include "tftlcd.h"

// defined in chinese_font_data.c
extern const cn_glyph_t g_cn_font[];
extern const uint16_t    g_cn_font_num;

const uint8_t* CN_FindGlyph(uint16_t unicode)
{
    for (uint16_t i = 0u; i < g_cn_font_num; i++)
    {
        if (g_cn_font[i].unicode == unicode)
            return g_cn_font[i].data;
    }
    return (const uint8_t*)0;
}

void LCD_ShowChinese(uint16_t x, uint16_t y, uint16_t color, const uint8_t* g)
{
    if (g == (const uint8_t*)0) return;
    for (uint8_t row = 0u; row < 16u; row++)
    {
        uint8_t b0 = g[row * 2u];
        uint8_t b1 = g[row * 2u + 1u];
        for (uint8_t col = 0u; col < 8u; col++)
        {
            if (b0 & (0x80u >> col)) LCD_Draw_ColorPoint(x + col,       y + row, color);
        }
        for (uint8_t col = 0u; col < 8u; col++)
        {
            if (b1 & (0x80u >> col)) LCD_Draw_ColorPoint(x + 8u + col, y + row, color);
        }
    }
}

// Draw a UTF-8 byte string (CJK 3-byte + ASCII 1-byte mixed).
// Returns the drawn pixel width so the caller can advance / right-align.
uint16_t LCD_ShowChineseStr(uint16_t x, uint16_t y, uint16_t color, const uint8_t* utf8)
{
    uint16_t cx = x;
    const uint8_t* p = utf8;
    if (p == (const uint8_t*)0) return 0u;
    while (*p)
    {
        uint32_t code = 0u;
        uint8_t  len  = 0u;
        if (*p < 0x80u)
        {
            code = *p; len = 1u;
        }
        else if ((*p & 0xE0u) == 0xC0u)
        {
            code = ((uint32_t)(*p & 0x1Fu) << 6)  | ((uint32_t)(*(p + 1) & 0x3Fu));
            len = 2u;
        }
        else if ((*p & 0xF0u) == 0xE0u)
        {
            code = ((uint32_t)(*p & 0x0Fu) << 12) | ((uint32_t)(*(p + 1) & 0x3Fu) << 6)
                 | ((uint32_t)(*(p + 2) & 0x3Fu));
            len = 3u;
        }
        else
        {
            p++; continue;   // skip invalid lead byte
        }

        if (len == 3u)
        {
            const uint8_t* g = CN_FindGlyph((uint16_t)code);
            LCD_ShowChinese(cx, y, color, g);
            cx += 16u;
        }
        else if (len == 1u)
        {
            LCD_ShowChar(cx, y, (char)code, 16u);   // reuse existing ASCII font
            cx += 8u;
        }
        p += len;
    }
    return (uint16_t)(cx - x);
}
